#define HOST_OS 1
#include "zmk-helpers/key-labels/36.h"

#include <behaviors.dtsi>
#include <behaviors/num_word.dtsi> // requires auto-layer module
#include <dt-bindings/zmk/keys.h>
#include <dt-bindings/zmk/bt.h>
#include "zmk-helpers/helper.h"
#include "mouse.dtsi"

#define DEF 0
#define NAV 1
#define NUM 2
#define SYM 3
#define FUN 4
#define SYS 5
#define MOUSE 6

#define XXX &none
#define ___ &trans

/* Global defaults */

#define QUICK_TAP_MS 175

&num_word {
  continue-list = <BSPC DEL DOT COMMA MINUS>;
};

&lt {
  flavor = "tap-preferred";
  tapping-term-ms = <200>;
  quick-tap-ms = <QUICK_TAP_MS>;
};

&mt {
  flavor = "tap-preferred";
  tapping-term-ms = <200>;
  quick-tap-ms = <QUICK_TAP_MS>;
};

/* Homerow mods */

#define KEYS_L LT0 LT1 LT2 LT3 LT4 LM0 LM1 LM2 LM3 LM4 LB0 LB1 LB2 LB3 LB4
#define KEYS_R RT0 RT1 RT2 RT3 RT4 RM0 RM1 RM2 RM3 RM4 RB0 RB1 RB2 RB3 RB4
#define THUMBS LH2 LH1 LH0 RH0 RH1 RH2

#define MAKE_HRM(NAME, HOLD, TAP, TRIGGER_POS)                                 \
  ZMK_HOLD_TAP(NAME, bindings = <HOLD>, <TAP>; flavor = "balanced";            \
               tapping-term-ms = <280>; quick-tap-ms = <QUICK_TAP_MS>;         \
               require-prior-idle-ms = <100>; hold-trigger-on-release;         \
               hold-trigger-key-positions = <TRIGGER_POS>;)

MAKE_HRM(hml, &kp, &kp, KEYS_R THUMBS) // Left-hand HRMs.
MAKE_HRM(hmr, &kp, &kp, KEYS_L THUMBS) // Right-hand HRMs.

MAKE_HRM(hmll, &mo, &kp, KEYS_R THUMBS) // Left-hand layer HRMs.
MAKE_HRM(hmrl, &mo, &kp, KEYS_L THUMBS) // Right-hand layer HRMs.

#define MAKE_MNAV(NAME, MOD)                   \
  ZMK_MACRO(NAME, wait-ms = <0>; tap-ms = <0>; \
            bindings =                         \
              <&macro_press &mo NAV>,          \
              <&macro_press &kp MOD>,          \
              <&macro_pause_for_release>,      \
              <&macro_release &kp MOD>,        \
              <&macro_release &mo NAV>;)

#define MAKE_MTMNAV(NAME, MNAV)                   \
  ZMK_BEHAVIOR(NAME, hold_tap, flavor = "tap-preferred"; tapping-term-ms = <200>; \
  quick-tap-ms = <QUICK_TAP_MS>; bindings = <MNAV>, <&kp>;)

MAKE_MNAV(gnav, LGUI)
MAKE_MNAV(anav, LALT)
MAKE_MNAV(cnav, LCTRL)
MAKE_MNAV(snav, LSHIFT)
MAKE_MTMNAV(mtgnav, &gnav)
MAKE_MTMNAV(mtanav, &anav)
MAKE_MTMNAV(mtcnav, &cnav)
MAKE_MTMNAV(mtsnav, &snav)

#include "combos.dtsi"

ZMK_LAYER(base,
// ╭─────────────┬─────────────┬─────────────┬─────────────┬─────────────╮   ╭─────────────┬─────────────┬─────────────┬─────────────┬─────────────╮
        &kp F         &kp P         &kp D         &kp L         &kp X           &kp SEMI        &kp U         &kp O         &kp Y         &kp B
// ├─────────────┼─────────────┼─────────────┼─────────────┼─────────────┤   ├─────────────┼─────────────┼─────────────┼─────────────┼─────────────┤
     &hml LGUI S   &hml LALT N  &hml LCTRL T  &hml LSHIFT H     &kp K           &kp COMMA   &hmr LSHIFT A &hmr RCTRL E   &hmr LALT I   &hmr RGUI C
// ├─────────────┼─────────────┼─────────────┼─────────────┼─────────────┤   ├─────────────┼─────────────┼─────────────┼─────────────┼─────────────┤
        &kp V         &kp W         &kp G         &kp M         &kp J           &kp MINUS      &kp DOT      &kp APOS     &kp EQUAL     &kp SLASH
// ╰─────────────┴─────────────┼─────────────┼─────────────┼─────────────┤   ├─────────────┼─────────────┼─────────────┼─────────────┴─────────────╯
                                &mt LGUI TAB   &lt NAV R   &lt MOUSE ESC       &lt SYM RET  &lt NUM SPACE   &kp BSPC
//                             ╰─────────────┴─────────────┴─────────────╯   ╰─────────────┴─────────────┴─────────────╯
)

/* ZMK_LAYER(nav, */
/* // ╭─────────────┬─────────────┬─────────────┬─────────────┬─────────────╮   ╭─────────────┬─────────────┬─────────────┬─────────────┬─────────────╮ */
/*          XXX           XXX           XXX           XXX           XXX               XXX      &kp LC(PGUP)       XXX      &kp LC(PGDN)       XXX */
/* // ├─────────────┼─────────────┼─────────────┼─────────────┼─────────────┤   ├─────────────┼─────────────┼─────────────┼─────────────┼─────────────┤ */
/*       &kp LGUI      &kp LALT      &kp LCTRL    &kp LSHIFT        XXX            &kp LEFT     &kp DOWN      &kp UP        &kp RIGHT         XXX */
/* // ├─────────────┼─────────────┼─────────────┼─────────────┼─────────────┤   ├─────────────┼─────────────┼─────────────┼─────────────┼─────────────┤ */
/*          XXX           XXX           XXX       &kp DOT           XXX            &kp HOME     &kp PGDN      &kp PGUP      &kp END           XXX */
/* // ╰─────────────┴─────────────┼─────────────┼─────────────┼─────────────┤   ├─────────────┼─────────────┼─────────────┼─────────────┴─────────────╯ */
/*                                      XXX           XXX           XXX               ___        &mo FUN          ___ */
/* //                             ╰─────────────┴─────────────┴─────────────╯   ╰─────────────┴─────────────┴─────────────╯ */
/* ) */

/* JKL; style */
ZMK_LAYER(nav,
// ╭─────────────┬─────────────┬─────────────┬─────────────┬─────────────╮   ╭─────────────┬─────────────┬─────────────┬─────────────┬─────────────╮
         XXX       &kp LC(PGUP)      XXX       &kp LC(PGDN)      XXX               XXX        &kp HOME     &kp PGDN      &kp PGUP      &kp END
// ├─────────────┼─────────────┼─────────────┼─────────────┼─────────────┤   ├─────────────┼─────────────┼─────────────┼─────────────┼─────────────┤
      &kp LGUI      &kp LALT      &kp LCTRL    &kp LSHIFT        XXX               XXX        &kp LEFT     &kp DOWN      &kp UP        &kp RIGHT
// ├─────────────┼─────────────┼─────────────┼─────────────┼─────────────┤   ├─────────────┼─────────────┼─────────────┼─────────────┼─────────────┤
         XXX           XXX           XXX           XXX           XXX               XXX        &kp DOT      &kp LC(D)     &kp LC(U)         XXX
// ╰─────────────┴─────────────┼─────────────┼─────────────┼─────────────┤   ├─────────────┼─────────────┼─────────────┼─────────────┴─────────────╯
                                     XXX           XXX           XXX               XXX           XXX           XXX
//                             ╰─────────────┴─────────────┴─────────────╯   ╰─────────────┴─────────────┴─────────────╯
)

/* IJKL style */
/* ZMK_LAYER(nav, */
/* // ╭─────────────┬─────────────┬─────────────┬─────────────┬─────────────╮   ╭─────────────┬─────────────┬─────────────┬─────────────┬─────────────╮ */
/*          XXX           XXX           XXX           XXX           XXX               XXX        &kp PGUP      &kp UP        &kp PGDN         XXX */
/* // ├─────────────┼─────────────┼─────────────┼─────────────┼─────────────┤   ├─────────────┼─────────────┼─────────────┼─────────────┼─────────────┤ */
/*       &kp LGUI      &kp LALT      &kp LCTRL    &kp LSHIFT        XXX             &kp HOME     &kp LEFT      &kp DOWN      &kp RIGHT     &kp END */
/* // ├─────────────┼─────────────┼─────────────┼─────────────┼─────────────┤   ├─────────────┼─────────────┼─────────────┼─────────────┼─────────────┤ */
/*          XXX           XXX           XXX           XXX           XXX             &kp MINUS    &kp DOT       &kp APOS      &kp EQUAL        XXX */
/* // ╰─────────────┴─────────────┼─────────────┼─────────────┼─────────────┤   ├─────────────┼─────────────┼─────────────┼─────────────┴─────────────╯ */
/*                                      XXX           XXX           XXX               ___        &mo FUN          ___ */
/* //                             ╰─────────────┴─────────────┴─────────────╯   ╰─────────────┴─────────────┴─────────────╯ */
/* ) */

ZMK_LAYER(num,
// ╭─────────────┬─────────────┬─────────────┬─────────────┬─────────────╮   ╭─────────────┬─────────────┬─────────────┬─────────────┬─────────────╮
         XXX         &kp N4        &kp N5        &kp N6         &kp X              XXX           XXX           XXX           XXX           XXX
// ├─────────────┼─────────────┼─────────────┼─────────────┼─────────────┤   ├─────────────┼─────────────┼─────────────┼─────────────┼─────────────┤
       &kp N0        &kp N1        &kp N2        &kp N3         &kp K              XXX           XXX        &kp DOWN      &kp UP           XXX
// ├─────────────┼─────────────┼─────────────┼─────────────┼─────────────┤   ├─────────────┼─────────────┼─────────────┼─────────────┼─────────────┤
         XXX         &kp N7        &kp N8        &kp N9         &kp J            &kp MINUS    &kp DOT       &kp ASTRK     &kp PLUS     &kp SLASH
// ╰─────────────┴─────────────┼─────────────┼─────────────┼─────────────┤   ├─────────────┼─────────────┼─────────────┼─────────────┴─────────────╯
                                  &kp LS(G)      &kp N0         &kp RET            XXX           XXX           XXX
//                             ╰─────────────┴─────────────┴─────────────╯   ╰─────────────┴─────────────┴─────────────╯
)

ZMK_LAYER(sym,
// ╭─────────────┬─────────────┬─────────────┬─────────────┬─────────────╮   ╭─────────────┬─────────────┬─────────────┬─────────────┬─────────────╮
      &kp BSLH      &kp RPAR      &kp RBRC      &kp RBKT         XXX            &kp COLON    &kp ASTRK     &kp PERCENT    &kp CARET     &kp GRAVE
// ├─────────────┼─────────────┼─────────────┼─────────────┼─────────────┤   ├─────────────┼─────────────┼─────────────┼─────────────┼─────────────┤
      &kp TILDE     &kp LPAR      &kp LBRC      &kp LBKT      &kp PIPE          &kp LT         &kp EXCL     &kp HASH     &kp DOLLAR     &kp AMPS
// ├─────────────┼─────────────┼─────────────┼─────────────┼─────────────┤   ├─────────────┼─────────────┼─────────────┼─────────────┼─────────────┤
         XXX           XXX           XXX           XXX           XXX            &kp UNDER      &kp GT       &kp DQT       &kp PLUS      &kp QMARK
// ╰─────────────┴─────────────┼─────────────┼─────────────┼─────────────┤   ├─────────────┼─────────────┼─────────────┼─────────────┴─────────────╯
                                     XXX        &mo FUN          XXX               XXX           XXX           XXX
//                             ╰─────────────┴─────────────┴─────────────╯   ╰─────────────┴─────────────┴─────────────╯
)

/* ZMK_LAYER(fun, */
/* // ╭─────────────┬─────────────┬─────────────┬─────────────┬─────────────╮   ╭─────────────┬─────────────┬─────────────┬─────────────┬─────────────╮ */
/*      &kp LG(ESC)     &kp F4        &kp F5        &kp F6          XXX               XXX           XXX           XXX           XXX       &kp PSCRN */
/* // ├─────────────┼─────────────┼─────────────┼─────────────┼─────────────┤   ├─────────────┼─────────────┼─────────────┼─────────────┼─────────────┤ */
/*        &kp F10       &kp F1        &kp F2        &kp F3       &kp F12           &kp C_PREV   &kp C_VOL_DN  &kp C_VOL_UP   &kp C_NEXT       XXX */
/* // ├─────────────┼─────────────┼─────────────┼─────────────┼─────────────┤   ├─────────────┼─────────────┼─────────────┼─────────────┼─────────────┤ */
/*        &kp F11       &kp F7        &kp F8        &kp F9          XXX              XXX      &kp  C_PP     &kp C_MUTE         XXX            XXX */
/* // ╰─────────────┴─────────────┼─────────────┼─────────────┼─────────────┤   ├─────────────┼─────────────┼─────────────┼─────────────┴─────────────╯ */
/*                                      XXX           XXX           XXX               XXX           XXX           XXX */
/* //                             ╰─────────────┴─────────────┴─────────────╯   ╰─────────────┴─────────────┴─────────────╯ */
/* ) */

ZMK_LAYER(fun,
// ╭─────────────┬─────────────┬─────────────┬─────────────┬─────────────╮   ╭─────────────┬─────────────┬─────────────┬─────────────┬─────────────╮
     &kp LG(ESC)     &kp F4        &kp F5        &kp F6          XXX               XXX           XXX           XXX           XXX       &kp PSCRN
// ├─────────────┼─────────────┼─────────────┼─────────────┼─────────────┤   ├─────────────┼─────────────┼─────────────┼─────────────┼─────────────┤
       &kp F10       &kp F1        &kp F2        &kp F3       &kp F12              XXX      &kp C_PREV  &kp C_VOL_DN   &kp C_VOL_UP    &kp C_NEXT
// ├─────────────┼─────────────┼─────────────┼─────────────┼─────────────┤   ├─────────────┼─────────────┼─────────────┼─────────────┼─────────────┤
       &kp F11       &kp F7        &kp F8        &kp F9          XXX              XXX       &kp  C_PP     &kp C_MUTE         XXX         XXX
// ╰─────────────┴─────────────┼─────────────┼─────────────┼─────────────┤   ├─────────────┼─────────────┼─────────────┼─────────────┴─────────────╯
                                     XXX           XXX           XXX               XXX           XXX           XXX
//                             ╰─────────────┴─────────────┴─────────────╯   ╰─────────────┴─────────────┴─────────────╯
)

ZMK_LAYER(sys,
// ╭─────────────┬─────────────┬─────────────┬─────────────┬─────────────╮   ╭─────────────┬─────────────┬─────────────┬─────────────┬─────────────╮
    &bt BT_SEL 0  &bt BT_SEL 1  &bt BT_SEL 2  &bt BT_SEL 3   &bt BT_CLR            XXX           XXX           XXX           XXX           XXX
// ├─────────────┼─────────────┼─────────────┼─────────────┼─────────────┤   ├─────────────┼─────────────┼─────────────┼─────────────┼─────────────┤
         XXX          XXX           XXX            XXX       &bootloader       &bootloader       XXX           XXX           XXX           XXX
// ├─────────────┼─────────────┼─────────────┼─────────────┼─────────────┤   ├─────────────┼─────────────┼─────────────┼─────────────┼─────────────┤
         XXX          XXX           XXX            XXX       &sys_reset        &sys_reset        XXX           XXX           XXX           XXX
// ╰─────────────┴─────────────┼─────────────┼─────────────┼─────────────┤   ├─────────────┼─────────────┼─────────────┼─────────────┴─────────────╯
                                     XXX           XXX           XXX               XXX           XXX           XXX
//                             ╰─────────────┴─────────────┴─────────────╯   ╰─────────────┴─────────────┴─────────────╯
)

ZMK_LAYER(mouse,
// ╭─────────────┬─────────────┬─────────────┬─────────────┬─────────────╮   ╭─────────────┬─────────────┬─────────────┬─────────────┬─────────────╮
         XXX           XXX           XXX           XXX           XXX               XXX        &kp PG_DN     &kp PG_UP        XXX           XXX
// ├─────────────┼─────────────┼─────────────┼─────────────┼─────────────┤   ├─────────────┼─────────────┼─────────────┼─────────────┼─────────────┤
         XXX           XXX           XXX           XXX           XXX               XXX        U_MS_L        U_MS_D        U_MS_U        U_MS_R
// ├─────────────┼─────────────┼─────────────┼─────────────┼─────────────┤   ├─────────────┼─────────────┼─────────────┼─────────────┼─────────────┤
         XXX           XXX           XXX           XXX           XXX               XXX        &mkp LCLK     &mkp MCLK    &mkp RCLK         XXX
// ╰─────────────┴─────────────┼─────────────┼─────────────┼─────────────┤   ├─────────────┼─────────────┼─────────────┼─────────────┴─────────────╯
                                  &mkp RCLK     &mkp MCLK     &mkp LCLK            XXX        &mkp LCLK        XXX
//                             ╰─────────────┴─────────────┴─────────────╯   ╰─────────────┴─────────────┴─────────────╯
)

/* ZMK_LAYER(mouse, */
/* //╭─────────────┬─────────────┬─────────────┬─────────────┬─────────────╮ ╭─────────────┬─────────────┬─────────────┬─────────────┬─────────────╮ */
/*         XXX           XXX           XXX           XXX           XXX             XXX       &kp PG_DN       U_MS_U       &kp PG_UP        XXX */
/* //├─────────────┼─────────────┼─────────────┼─────────────┼─────────────┤ ├─────────────┼─────────────┼─────────────┼─────────────┼─────────────┤ */
/*         XXX        &mkp LCLK     &mkp MCLK     &mkp RCLK        XXX           U_WH_L        U_MS_L        U_MS_D        U_MS_R        U_WH_R */
/* //├─────────────┼─────────────┼─────────────┼─────────────┼─────────────┤ ├─────────────┼─────────────┼─────────────┼─────────────┼─────────────┤ */
/*         XXX           XXX           XXX           XXX           XXX             XXX         U_WH_D        U_WH_U          XXX           XXX */
/* //╰─────────────┼─────────────┴─────────────┼─────────────┼─────────────┤ ├─────────────┼─────────────┼─────────────┴───────────────────────────╯ */
/*                                     XXX           XXX           XXX         &mkp LCLK     &mkp MCLK     &mkp RCLK */
/* //                            ╰─────────────┴─────────────┴─────────────╯ ╰─────────────┴─────────────┴─────────────╯ */
/* ) */

/* ZMK_LAYER(foo, */
/* // ╭─────────────┬─────────────┬─────────────┬─────────────┬─────────────╮   ╭─────────────┬─────────────┬─────────────┬─────────────┬─────────────╮ */
/*          XXX           XXX           XXX           XXX           XXX               XXX           XXX           XXX           XXX           XXX */
/* // ├─────────────┼─────────────┼─────────────┼─────────────┼─────────────┤   ├─────────────┼─────────────┼─────────────┼─────────────┼─────────────┤ */
/*          XXX           XXX           XXX           XXX           XXX               XXX           XXX           XXX           XXX           XXX */
/* // ├─────────────┼─────────────┼─────────────┼─────────────┼─────────────┤   ├─────────────┼─────────────┼─────────────┼─────────────┼─────────────┤ */
/*          XXX           XXX           XXX           XXX           XXX               XXX           XXX           XXX           XXX           XXX */
/* // ╰─────────────┴─────────────┼─────────────┼─────────────┼─────────────┤   ├─────────────┼─────────────┼─────────────┼─────────────┴─────────────╯ */
/*                                      XXX           XXX           XXX               XXX           XXX           XXX */
/* //                             ╰─────────────┴─────────────┴─────────────╯   ╰─────────────┴─────────────┴─────────────╯ */
/* ) */
